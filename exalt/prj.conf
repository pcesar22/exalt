## CMakeLists.txt
```
# SPDX-License-Identifier: Apache-2.0

cmake_minimum_required(VERSION 3.20.0)

# Include local cache file if it exists
if(EXISTS ${CMAKE_CURRENT_SOURCE_DIR}/cmake/local.cmake)
  include(${CMAKE_CURRENT_SOURCE_DIR}/cmake/local.cmake)
endif()

find_package(Zephyr REQUIRED HINTS $ENV{ZEPHYR_BASE})

project(exalt)

# Include directories
target_include_directories(app PRIVATE include)

# Add source files
target_sources(app PRIVATE src/main.c)

# Add subdirectories
add_subdirectory(src)
```

## Kconfig
```
# Main application configuration options

# Application-specific configurations
menu "Application Services"

config EXALT_BLINK_SERVICE
    bool "Enable LED blinking service"
    default y
    depends on GPIO
    help
      Enable the LED blinking service.

if EXALT_BLINK_SERVICE

config EXALT_BLINK_THREAD_STACK_SIZE
    int "Blink service thread stack size"
    default 1024
    help
      Stack size for the blink service thread.

config EXALT_BLINK_THREAD_PRIORITY
    int "Blink service thread priority"
    default 5
    help
      Priority for the blink service thread.

endif # EXALT_BLINK_SERVICE

config EXALT_BLE_SERVICE
    bool "Enable Bluetooth service"
    default y
    depends on BT
    help
      Enable the Bluetooth service for controlling LED patterns.

if EXALT_BLE_SERVICE

config EXALT_BLE_DEVICE_NAME
    string "Bluetooth device name"
    default "Exalt"
    help
      Bluetooth device name used in advertisements.

endif # EXALT_BLE_SERVICE

endmenu

menu "Zephyr"
source "Kconfig.zephyr"
endmenu

module = EXALT
module-str = ExaltApp
source "subsys/logging/Kconfig.template.log_config"
```

## prj.conf
```kconfig
CONFIG_GPIO=y

CONFIG_LOG=y
CONFIG_EXALT_LOG_LEVEL_DBG=y

CONFIG_SERIAL=y
CONFIG_UART_CONSOLE=y

# Adding bluetooth settings
CONFIG_BT=y
CONFIG_BT_PERIPHERAL=y
CONFIG_BT_DEVICE_NAME="Exalt"
CONFIG_BT_DEVICE_APPEARANCE=833
CONFIG_BT_MAX_CONN=1


# Enable application services
CONFIG_EXALT_BLINK_SERVICE=y
CONFIG_EXALT_BLINK_THREAD_STACK_SIZE=1024
CONFIG_EXALT_BLINK_THREAD_PRIORITY=5

CONFIG_EXALT_BLE_SERVICE=y
CONFIG_EXALT_BLE_DEVICE_NAME="Exalt"

# Enable thread names
CONFIG_THREAD_NAME=y
CONFIG_INIT_STACKS=y
```

## src/main.c
```c
/******************************************************************************
 * Includes
 *****************************************************************************/
#include <zephyr/kernel.h>
#include <zephyr/logging/log.h>

#include <exalt/blink_service.h>
#include <exalt/ble_service.h>
#include <exalt/common.h>

/******************************************************************************
 * Log Module Registration
 *****************************************************************************/
LOG_MODULE_REGISTER(EXALT, CONFIG_EXALT_LOG_LEVEL);

/******************************************************************************
 * Main Function
 *****************************************************************************/
int main(void)
{
    LOG_INF("Exalt Application Starting...");

    // Initialize blink service
    int err = blink_service_init();
    if (err) {
        LOG_ERR("Failed to initialize blink service (err %d)", err);
        return err;
    }

    // Initialize BLE service
    err = ble_service_init();
    if (err) {
        LOG_ERR("Failed to initialize BLE service (err %d)", err);
        return err;
    }

    LOG_INF("All services initialized successfully");

    // Main application loop
    while (1) {
        // The main thread can perform other tasks or monitor overall system status
        k_sleep(K_SECONDS(10));
        LOG_INF("Main thread still running...");
    }

    return 0;
}
```

## src/main.cpp
```c
/*
 * Copyright (c) 2016 Intel Corporation
 *
 * SPDX-License-Identifier: Apache-2.0
 */

#include <stdio.h>
#include <zephyr/kernel.h>
#include <zephyr/drivers/gpio.h>

#include <zephyr/logging/log.h>
LOG_MODULE_REGISTER(EXALT, CONFIG_EXALT_LOG_LEVEL);

/* 1000 msec = 1 sec */
#define SLEEP_TIME_MS 1000

/* The devicetree node identifier for the "led0" alias. */
#define LED0_NODE DT_ALIAS(led0)

namespace
{
	void bt_ready(int err)
	{
		if (err)
		{
			LOG_ERR("Bluetooth init failed (err %d)");
		}
	}
}

/*
 * A build error on this line means your board is unsupported.
 * See the sample documentation for information on how to fix this.
 */
static const struct gpio_dt_spec led = GPIO_DT_SPEC_GET(LED0_NODE, gpios);

int main(void)
{
	int ret;
	bool led_state = true;
	LOG_INF("Hello Exalted");

	if (!gpio_is_ready_dt(&led))
	{
		return 0;
	}

	ret = gpio_pin_configure_dt(&led, GPIO_OUTPUT_ACTIVE);
	if (ret < 0)
	{
		return 0;
	}

	while (1)
	{
		ret = gpio_pin_toggle_dt(&led);
		if (ret < 0)
		{
			return 0;
		}

		led_state = !led_state;
		printf("LED state: %s\n", led_state ? "ON" : "OFF");
		k_msleep(SLEEP_TIME_MS);
	}
	return 0;
}
```
